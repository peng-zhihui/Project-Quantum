## 2.Bootloader/u-boot/configs/nanopi_h3_defconfig
```kconfig
CONFIG_ARM=y
CONFIG_ARCH_SUNXI=y
CONFIG_MACH_SUN8I_H3=y
CONFIG_MACH_SUN8I_H3_NANOPI=y
CONFIG_DRAM_CLK=408
CONFIG_DRAM_ZQ=3881979
CONFIG_DRAM_ODT_EN=y
CONFIG_MMC0_CD_PIN="PH13"
CONFIG_MMC_SUNXI_SLOT_EXTRA=2
CONFIG_R_I2C_ENABLE=y
# CONFIG_VIDEO_DE2 is not set
CONFIG_DEFAULT_DEVICE_TREE="sun8i-h3-nanopi-m1-plus"
# CONFIG_SYS_MALLOC_CLEAR_ON_INIT is not set
CONFIG_BOOTCOMMAND="fatload mmc 0:1 ${scriptaddr} boot.scr; source ${scriptaddr}"
CONFIG_CONSOLE_MUX=y
CONFIG_SPL=y
# CONFIG_CMD_BOOTEFI_HELLO_COMPILE is not set
CONFIG_CMD_MEMINFO=y
CONFIG_CMD_MEMTEST=y
# CONFIG_CMD_FLASH is not set
# CONFIG_CMD_FPGA is not set
# CONFIG_SPL_DOS_PARTITION is not set
# CONFIG_SPL_ISO_PARTITION is not set
# CONFIG_SPL_EFI_PARTITION is not set
CONFIG_ENV_OFFSET=0x200000
CONFIG_I2C_SET_DEFAULT_BUS_NUM=y
CONFIG_I2C_DEFAULT_BUS_NUMBER=0x5
CONFIG_SYS_USB_EVENT_POLL_VIA_INT_QUEUE=y
CONFIG_DISPLAY=y
```

## 3.Kernel/linux/Documentation/devicetree/bindings/display/sunxi/hdmi.txt
```
Allwinner HDMI Transmitter
==========================

The Allwinner HDMI transmitters are included in the SoCs.
They support audio and video.

Required properties:
 - #address-cells : should be <1>
 - #size-cells : should be <0>
 - compatible : should be one of
		"allwinner,sun8i-a83t-hdmi"
		"allwinner,sun8i-h3-hdmi"
 - clocks : phandles to the HDMI clocks as described in
	Documentation/devicetree/bindings/clock/clock-bindings.txt
 - clock-names : must be
		"gate" : bus gate
		"clock" : streaming clock
		"ddc-clock" : DDC clock
 - resets : One or two phandles to the HDMI resets
 - reset-names : when 2 phandles, must be
		"hdmi0" and "hdmi1"

Required nodes:
 - port: Audio and video input port nodes with endpoint definitions
	as defined in Documentation/devicetree/bindings/graph.txt.
	port@0 is video and port@1 is audio.

Example:

	hdmi: hdmi@01ee0000 {
		compatible = "allwinner,sun8i-a83t-hdmi";
		reg = <0x01ee0000 0x20000>;
		clocks = <&ccu CLK_BUS_HDMI>, <&ccu CLK_HDMI>,
			 <&ccu CLK_HDMI_DDC>;
		clock-names = "gate", "clock", "ddc-clock";
		resets = <&ccu RST_HDMI0>, <&ccu RST_HDMI1>;
		reset-names = "hdmi0", "hdmi1";
		...
		#address-cells = <1>;
		#size-cells = <0>;
		port@0 {			/* video */
			reg = <0>;
			hdmi_lcd1: endpoint {
				remote-endpoint = <&lcd1_hdmi>;
			};
		};
		port@1 {			/* audio */
			reg = <1>;
			hdmi_i2s2: endpoint {
				remote-endpoint = <&i2s2_hdmi>;
			};
		};
	};
```

## 3.Kernel/linux/Documentation/devicetree/bindings/display/sunxi/sun8i-de2.txt
```
Allwinner sun8i Display Engine 2 subsystem
==========================================

The Allwinner DE2 subsystem contains a display controller (DE2),
one or two LCD controllers (TCON) and their external interfaces.

Display controller
==================

Required properties:

- compatible: value should be one of the following
		"allwinner,sun8i-a83t-display-engine"
		"allwinner,sun8i-h3-display-engine"

- clocks: must include clock specifiers corresponding to entries in the
		clock-names property.

- clock-names: must contain
		"gate": DE bus gate
		"clock": DE clock

- resets: phandle to the reset of the device

- ports: phandle's to the LCD ports

LCD controller
==============

Required properties:

- compatible: should be
		"allwinner,sun8i-a83t-tcon"

- clocks: must include clock specifiers corresponding to entries in the
		clock-names property.

- clock-names: must contain
		"gate": TCON bus gate
		"clock": TCON pixel clock

- resets: phandle to the reset of the device

- port: port node with endpoint definitions as defined in
	Documentation/devicetree/bindings/media/video-interfaces.txt

Example:

	de: de-controller@01000000 {
		compatible = "allwinner,sun8i-h3-display-engine";
		...
		clocks = <&&ccu CLK_BUS_DE>, <&ccu CLK_DE>;
		clock-names = "gate", "clock";
		resets = <&ccu RST_BUS_DE>;
		ports = <&lcd0_p>;
	};

	lcd0: lcd-controller@01c0c000 {
		compatible = "allwinner,sun8i-a83t-tcon";
		...
		clocks = <&ccu CLK_BUS_TCON0>, <&ccu CLK_TCON0>;
		clock-names = "gate", "clock";
		resets = <&ccu RST_BUS_TCON0>;
		#address-cells = <1>;
		#size-cells = <0>;
		lcd0_p: port {
			lcd0_ep: endpoint {
				remote-endpoint = <&hdmi_ep>;
			};
		};
	};

	hdmi: hdmi@01ee0000 {
		...
		#address-cells = <1>;
		#size-cells = <0>;
		port {
			hdmi_ep: endpoint {
				remote-endpoint = <&lcd0_ep>;
			};
		};
	};
```

## 3.Kernel/linux/Documentation/devicetree/bindings/regulator/sy8106a-regulator.txt
```
SY8106A Voltage regulator

Required properties:
- compatible: Must be "silergy,sy8106a"
- reg: I2C slave address - must be <0x65>

Any property defined as part of the core regulator binding, defined in
regulator.txt, can also be used.

Example:

	sy8106a {
		compatible = "silergy,sy8106a";
		reg = <0x65>;
		regulator-name = "sy8106a-vdd";
		regulator-min-microvolt = <1000000>;
		regulator-max-microvolt = <1400000>;
		regulator-ramp-delay = <200>;
		regulator-boot-on;
		regulator-always-on;
	};
```

## 3.Kernel/linux/Documentation/devicetree/bindings/thermal/sun8i-ths.txt
```
* Thermal sensor driver for Allwinner H3 SoC

Required properties:
- compatible : "allwinner,sun8i-h3-ths"
- reg : Address range of the thermal sensor registers
- resets : Must contain phandles to reset controls matching the entries
  of the names
- reset-names : Must include the name "ahb"
- clocks : Must contain phandles to clock controls matching the entries
  of the names
- clock-names : Must contain "ahb" for the bus gate and "ths" for the THS
  clock

Example:
ths: ths@01c25000 {
	#thermal-sensor-cells = <0>;
	compatible = "allwinner,sun8i-h3-ths";
	reg = <0x01c25000 0x400>;
	interrupts = <GIC_SPI 63 IRQ_TYPE_LEVEL_HIGH>;
	resets = <&bus_rst 136>;
	reset-names = "ahb";
	clocks = <&bus_gates 72>, <&ths_clk>;
	clock-names = "ahb", "ths";
};
```

## 3.Kernel/linux/drivers/gpu/drm/sun8i/Kconfig
```kconfig
#
# Allwinner DE2 Video configuration
#

config DRM_SUN8I
	bool

config DRM_SUN8I_DE2
	tristate "Support for Allwinner Video with DE2 interface"
	depends on DRM && OF
	select DRM_GEM_CMA_HELPER
	select DRM_KMS_CMA_HELPER
	select DRM_KMS_HELPER
	select DRM_SUN8I
	help
	  Choose this option if your Allwinner chipset has the DE2 interface
	  as the A64, A83T and H3. If M is selected the module will be called
	  sun8i-de2-drm.

config DRM_SUN8I_DE2_HDMI
	tristate "Support for DE2 HDMI"
	depends on DRM_SUN8I_DE2
	help
	  Choose this option if you use want HDMI on DE2.
	  If M is selected the module will be called sun8i-de2-hdmi.
```

## 3.Kernel/linux/drivers/net/ethernet/allwinner/Kconfig
```kconfig
#
# Allwinner device configuration
#

config NET_VENDOR_ALLWINNER
	bool "Allwinner devices"
	default y

	depends on ARCH_SUNXI
	---help---
	  If you have a network (Ethernet) card belonging to this
	  class, say Y here.

	  Note that the answer to this question doesn't directly
	  affect the kernel: saying N will just cause the configurator
	  to skip all the questions about Allwinner cards. If you say Y,
	  you will be asked for your specific card in the following
	  questions.

if NET_VENDOR_ALLWINNER

config SUN4I_EMAC
        tristate "Allwinner A10 EMAC support"
	depends on ARCH_SUNXI
	depends on OF
	select CRC32
	select MII
	select PHYLIB
	select MDIO_SUN4I
        ---help---
          Support for Allwinner A10 EMAC ethernet driver.

          To compile this driver as a module, choose M here.  The module
          will be called sun4i-emac.

config SUN8I_EMAC
	tristate "Allwinner sun8i EMAC support"
	depends on ARCH_SUNXI || COMPILE_TEST
	depends on OF
	select MII
	select PHYLIB
        ---help---
	  This driver support the sun8i EMAC ethernet driver present on
	  H3/A83T/A64 Allwinner SoCs.

          To compile this driver as a module, choose M here.  The module
          will be called sun8i-emac.

endif # NET_VENDOR_ALLWINNER
```

## 3.Kernel/linux/net/wireguard/Kconfig
```kconfig
config WIREGUARD
	tristate "IP: WireGuard secure network tunnel"
	depends on NET && INET
	select NET_UDP_TUNNEL
	select CRYPTO_BLKCIPHER
	select VFP
	select VFPv3
	select NEON
	select KERNEL_MODE_NEON
	default m
	---help---
	  WireGuard is a secure, fast, and easy to use replacement for IPSec
	  that uses modern cryptography and clever networking tricks. It's
	  designed to be fairly general purpose and abstract enough to fit most
	  use cases, while at the same time remaining extremely simple to
	  configure. See www.wireguard.com for more info.

	  It's safe to say Y or M here, as the driver is very lightweight and
	  is only in use when an administrator chooses to add an interface.

config WIREGUARD_DEBUG
	bool "Debugging checks and verbose messages"
	depends on WIREGUARD
	---help---
	  This will write log messages for handshake and other events
	  that occur for a WireGuard interface. It will also perform some
	  extra validation checks and unit tests at various points. This is
	  only useful for debugging.

	  Say N here unless you know what you're doing.
```
