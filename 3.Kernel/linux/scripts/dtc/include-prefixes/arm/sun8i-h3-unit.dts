#include "sun8i-h3-linux_card.dtsi"

/ {
	model = "Pengzhihui Unit-Sever";
	compatible = "friendlyelec,nanopi-neo-core", "allwinner,sun8i-h3";
};


&i2c2_pins {
   bias-pull-up;
};

&i2c1_pins {
   bias-pull-up;
};

&i2c0_pins {
   bias-pull-up;
};
