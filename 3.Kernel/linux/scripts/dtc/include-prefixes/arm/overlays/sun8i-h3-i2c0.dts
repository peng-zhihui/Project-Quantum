/dts-v1/;
/plugin/;

/ {
	compatible = "allwinner,sun8i-h3";

	fragment@0 {
		target-path = "/aliases";
		__overlay__ {
			i2c0 = "/soc/i2c@01c2ac00";
		};
	};

	fragment@1 {
		target = <&i2c0>;
		 __overlay__ {
			pinctrl-names = "default";
			pinctrl-0 = <&i2c0_pins>;
			status = "okay";
		};
	};
};
