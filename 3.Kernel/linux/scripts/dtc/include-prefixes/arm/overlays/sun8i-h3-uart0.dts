/dts-v1/;
/plugin/;

/ {
	compatible = "allwinner,sun8i-h3";

	fragment@0 {
		target-path = "/aliases";
		__overlay__ {
			serial0 = "/soc/serial@01c28000";
		};
	};

	fragment@1 {
		target = <&uart0>;
		 __overlay__ {
			pinctrl-names = "default";
			pinctrl-0 = <&uart0_pins_a>;
			status = "okay";
		};
	};
};
