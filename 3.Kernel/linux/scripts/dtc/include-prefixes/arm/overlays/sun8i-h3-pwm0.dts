/dts-v1/;
/plugin/;

/ {
	compatible = "allwinner,sun8i-h3";

	fragment@0 {
		target-path = "/aliases";
		__overlay__ {
			pwm0 = "/soc/pwm@01c21400";
		};
	};

	fragment@1 {
		target = <&pwm>;
		 __overlay__ {
			pinctrl-names = "default";
			pinctrl-0 = <&pwm0_pins>;
			status = "okay";
		};
	};
};
