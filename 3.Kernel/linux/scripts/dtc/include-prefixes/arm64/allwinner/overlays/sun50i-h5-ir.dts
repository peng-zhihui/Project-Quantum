/dts-v1/;
/plugin/;

/ {
	compatible = "allwinner,sun8i-h3";

	fragment@0 {
		target-path = "/aliases";
		__overlay__ {
			ir = "/soc/ir@01f02000";
		};
	};

	fragment@1 {
		target = <&uart0>;
		 __overlay__ {
			pinctrl-names = "default";
			pinctrl-0 = <&ir_pins_a>;
			status = "okay";
		};
	};
};
