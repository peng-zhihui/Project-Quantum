// Overlay for sun50i-h5 gpio-dvfs
/dts-v1/;
/plugin/;

/{
    compatible = "friendlyelec,nanopi-neo2", "allwinner,sun50i-h5";

    fragment@0 {
        target = <&cpu0>;
        __overlay__ {
            operating-points = <
                1248000 1300000
                1008000 1100000
                816000  1100000
                624000  1100000
                480000  1100000
                >;
            #cooling-cells = <2>;
            cooling-min-level = <0>;
            cooling-max-level = <4>;
            cpu0-supply = <&vdd_cpux>;
        };
    };

    fragment@1 {
        target = <&vdd_cpux>;
        __overlay__ {
            compatible = "regulator-gpio";

            regulator-name = "vdd-cpux";
            regulator-type = "voltage";
            regulator-boot-on;
            regulator-always-on;
            regulator-min-microvolt = <1100000>;
            regulator-max-microvolt = <1300000>;
            regulator-ramp-delay = <50>; /* 4ms */
            gpios-states = <0x1>;
            states = <1100000 0x0
                  1300000 0x1>;
        };
    };
};
