/dts-v1/;
/plugin/;

/ {
	compatible = "allwinner,sun8i-h3";

	fragment@0 {
		target-path = "/aliases";
		__overlay__ {
			spi0 = "/soc/i2c@01c68000";
		};
	};

	fragment@1 {
		target = <&spi0>;
		 __overlay__ {
			pinctrl-names = "default";
			pinctrl-0 = <&spi0_pins>;
			status = "okay";
		};
	};
};
