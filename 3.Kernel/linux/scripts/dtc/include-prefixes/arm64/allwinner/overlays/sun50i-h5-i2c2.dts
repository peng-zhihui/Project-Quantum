/dts-v1/;
/plugin/;

/ {
	compatible = "allwinner,sun8i-h3";

	fragment@0 {
		target-path = "/aliases";
		__overlay__ {
			i2c2 = "/soc/i2c@01c2b400";
		};
	};

	fragment@1 {
		target = <&i2c2>;
		 __overlay__ {
			pinctrl-names = "default";
			pinctrl-0 = <&i2c2_pins>;
			status = "okay";
		};
	};
};
